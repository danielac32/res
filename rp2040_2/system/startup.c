#include <os.h>
extern int main(void);

extern void _stack_top(void);
extern unsigned int _text;
extern unsigned int _etext;
extern unsigned int _data;
extern unsigned int _edata;
extern unsigned int _bss;
extern unsigned int _ebss;
extern unsigned int _min_stack_sz;
void irq_handler_reset(void);

//-----------------------------------------------------------------------------
__attribute__ ((used, section(".vectors")))
void (* const vectors[])(void) =
{
  &_stack_top,                   // 0 - Initial Stack Pointer Value
  irq_handler_reset             // 1  - Reset
};

//-----------------------------------------------------------------------------
void irq_handler_reset(void)
{
  unsigned int *src, *dst;

  src = &_etext;
  dst = &_data;
  while (dst < &_edata)
    *dst++ = *src++;

  dst = &_bss;
  while (dst < &_ebss)
    *dst++ = 0;


    nvic_init();
    
    xosc_init();
    IO_WR(CLOCKS_BASE+0x48, 0x880); // clk_peri enble

    reset_release_wait(RESET_IO_BANK0);
    reset_release_wait(RESET_PADS_BANK0);
    reset_release_wait(RESET_UART0);

    uart_init(0, 115200);
    gpio_init(0, GPIO_FUNC_UART);
    gpio_init(1, GPIO_FUNC_UART);
    gpio_dir(0, 1);
 
 
    gpio_init(25, GPIO_FUNC_SIO);
    gpio_dir(25, 1);
    

    UART_TxHead = 0;
    UART_TxTail = 0;
    UART_RxHead = 0;
    UART_RxTail = 0;

    uart_intr_enable(0, 1, 0);
    nvic_register_irq(IRQ_UART0, irq_uart0);
    nvic_enable(IRQ_UART0);
 
    gpio_init(25, GPIO_FUNC_SIO);
    gpio_dir(25, 1);
    mm_init();

 
    systick_init();
    systick_set(12000000);
    
    printf("bytes of code : %10d \n",(uint32_t)&_etext - (uint32_t)&_text);
    printf("              [0x%08X to 0x%08X]\n",(uint32_t)&_text, (uint32_t)&_etext);
    printf("bytes of data : %10d \n",(uint32_t)&_ebss - (uint32_t)&_data);
    printf("              [0x%08X to 0x%08X]\n\n",(uint32_t)&_data, (uint32_t)&_ebss);
    printf("bytes of stack : %10d \n",(uint32_t)&_min_stack_sz);
    printf("[0x%08X]\n\n",(uint32_t)&_stack_top);

    main();

 // main();

  while (1);
}

//-----------------------------------------------------------------------------
 
 

/* the first 256 bytes is CRC-32 protected bootstrap code to configure the flash QSPI */

__attribute__ ((used, section(".boot")))
const uint8_t bs2[] =
{
  0x00, 0xb5, 0x32, 0x4b, 0x21, 0x20, 0x58, 0x60, 0x98, 0x68, 0x02, 0x21, 0x88, 0x43, 0x98, 0x60,
  0xd8, 0x60, 0x18, 0x61, 0x58, 0x61, 0x2e, 0x4b, 0x00, 0x21, 0x99, 0x60, 0x02, 0x21, 0x59, 0x61,
  0x01, 0x21, 0xf0, 0x22, 0x99, 0x50, 0x2b, 0x49, 0x19, 0x60, 0x01, 0x21, 0x99, 0x60, 0x35, 0x20,
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  0x00, 0x00, 0x00, 0x00, 0x00, 0x00, 0x00, 0x00, 0x00, 0x00, 0x00, 0x00, 0x74, 0xb2, 0x4e, 0x7a,
};

