
asm("li sp,370000  \n\t"
    "li gp,0x840   \n\t" //antes del puntero de entrada
    "j main       \n\t"
);


#include <stdint.h>
#include <string.h>
#include "serial.h" 

#define base_io 0xFA000
#define MODE (*(volatile uint8_t *)0xFA001)
#define TX (*(volatile uint8_t *)0xFA002)
#define TIMER0 (*(volatile uint32_t *)0xFA003)
#define ENT0 (*(volatile uint8_t *)0xFA004)
#define ENRX (*(volatile uint8_t *)0xFA005)
#define RX (*(volatile uint8_t *)0xFA006)
#define LED0 (*(volatile uint8_t *)0xFA007)

/*
#define save_context       \
asm("nop              ");   \
asm("nop              ");   \
asm("nop              ");   \
asm("nop              ");   \
asm("nop              ");   \
asm("addi  sp,sp,-120 ");  \
asm("sw    ra,116(sp) ");  \
asm("sw    t6,112(sp) ");  \
asm("sw    t5,108(sp) ");  \
asm("sw    t4,104(sp) ");  \
asm("sw    t3,100(sp) ");  \
asm("sw    s11,96(sp) ");  \
asm("sw    s10,92(sp) ");  \
asm("sw    s9,88(sp)  ");  \
asm("sw    s8,84(sp)  ");  \
asm("sw    s7,80(sp)  ");  \
asm("sw    s6,76(sp)  ");  \
asm("sw    s5,72(sp)  ");  \
asm("sw    s4,68(sp)  ");  \
asm("sw    s3,64(sp)  ");  \
asm("sw    s2,60(sp)  ");  \
asm("sw    a7,56(sp)  ");  \
asm("sw    a6,52(sp)  ");  \
asm("sw    a5,48(sp)  ");  \
asm("sw    a4,44(sp)  ");  \
asm("sw    a3,40(sp)  ");  \
asm("sw    a2,36(sp)  ");  \
asm("sw    a1,32(sp)  ");  \
asm("sw    a0,28(sp)  ");  \
asm("sw    s1,24(sp)  ");  \
asm("sw    s0,20(sp)  ");  \
asm("sw    t2,16(sp)  ");  \
asm("sw    t1,12(sp)  ");  \
asm("sw    t0,8(sp)   ");  \
asm("sw    tp,4(sp)   ");  \
asm("sw    gp,0(sp)   ");  

#define restore_context    \
asm("nop              ");   \
asm("lw    ra,116(sp) ");   \
asm("lw    t6,112(sp) ");   \
asm("lw    t5,108(sp) ");   \
asm("lw    t4,104(sp) ");   \
asm("lw    t3,100(sp) ");   \
asm("lw    s11,96(sp) ");   \
asm("lw    s10,92(sp) ");   \
asm("lw    s9,88(sp)  ");   \
asm("lw    s8,84(sp)  ");   \
asm("lw    s7,80(sp)  ");   \
asm("lw    s6,76(sp)  ");   \
asm("lw    s5,72(sp)  ");   \
asm("lw    s4,68(sp)  ");   \
asm("lw    s3,64(sp)  ");   \
asm("lw    s2,60(sp)  ");   \
asm("lw    a7,56(sp)  ");   \
asm("lw    a6,52(sp)  ");   \
asm("lw    a5,48(sp)  ");   \
asm("lw    a4,44(sp)  ");   \
asm("lw    a3,40(sp)  ");   \
asm("lw    a2,36(sp)  ");   \
asm("lw    a1,32(sp)  ");   \
asm("lw    a0,28(sp)  ");   \
asm("lw    s1,24(sp)  ");   \
asm("lw    s0,20(sp)  ");   \
asm("lw    t2,16(sp)  ");   \
asm("lw    t1,12(sp)  ");   \
asm("lw    t0,8(sp)   ");   \
asm("lw    tp,4(sp)   ");   \
asm("lw    gp,0(sp)   ");   \
asm("addi  sp,sp,120  ");   \
asm("uret             ");   

*/

 unsigned char rawData2[] = {
  0x6F, 0x00, 0xC0, 0x08, 0x13, 0x01, 0x01, 0xFE, 0x23, 0x2E, 0x81, 0x00,
  0x13, 0x04, 0x01, 0x02, 0x93, 0x07, 0x05, 0x00, 0xA3, 0x07, 0xF4, 0xFE,
  0xB7, 0xA7, 0x0F, 0x00, 0x93, 0x87, 0x27, 0x00, 0x03, 0x47, 0xF4, 0xFE,
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  0x83, 0x20, 0xC1, 0x01, 0x03, 0x24, 0x81, 0x01, 0x13, 0x01, 0x01, 0x02,
  0x67, 0x80, 0x00, 0x00, 0x00, 0x00, 0x00, 0x00,' ',' ',' ',' ',' ',' ',' ',' ',' ',' ',' ',' ',' ',' ',' ',' ',' ',' ',' ',' ',' ',' ',' ',' ',' ',' ',' ', 'a', 'p', 'p', ' ',
  'i', 'n', 's', 'i','d','e',' ','r','a','m', 0x0A, 0x00
};


 unsigned char rawData[246] = {
    0x6F, 0x00, 0xC0, 0x08, 0x13, 0x01, 0x01, 0xFE, 0x23, 0x2E, 0x81, 0x00,
    0x13, 0x04, 0x01, 0x02, 0x93, 0x07, 0x05, 0x00, 0xA3, 0x07, 0xF4, 0xFE,
    0xB7, 0xA7, 0x0F, 0x00, 0x93, 0x87, 0x27, 0x00, 0x03, 0x47, 0xF4, 0xFE,
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    0x74, 0x65, 0x73, 0x74, 0x0A, 0x00
};






void fibo(long n){
long t1=0,t2=1,nextTerm;
for (int i = 1; i <= n; ++i)
{
     myprintf("%d ",t1);
     nextTerm = t1 + t2;
     t1=t2;
     t2=nextTerm;
}
 
}
int counter=0;

void cal(){
	  myprintf("fibonacci start\n");
      fibo(50);
      myprintf("\nfibonacci end\n");
}

void int_isr(){
	  myprintf("\t\tinterrupt\n");
      cal();
      myprintf("\n");
      if(!(counter % 10)){
      	counter=0;
          void (*p)(void);


          for (int i = 0; i < 3; ++i)
          {
          	p=(void*)rawData;
          (*p)();

          p=(void*)rawData2;
          (*p)();
          }
      }
      counter++;
}



void __attribute__ ((section(".interrupt"))) isr(){    
      //save_context;
	  asm("nop");
	  asm("nop");
      int_isr();
      //restore_context;
      asm("uret");  
} 



static char instructions_msg[]= " \
\n\
                   riscv.\n\
\n\
         5555555555555555555555555\n\
        5555                   5555\n\
       5555                     5555\n\
      5555                       5555\n\
     5555       5555555555555555555555\n\
    5555       555555555555555555555555\n\
   5555                             5555\n\
  5555                               5555\n\
 5555                                 5555\n\
5555555555555555555555555555          55555\n\
 55555           555555555           55555\n\
   55555           55555           55555\n\
     55555           5           55555\n\
       55555                   55555\n\
         55555               55555\n\
           55555           55555\n\
             55555       55555\n\
               55555   55555\n\
                 555555555\n\
                   55555\n\
                     5\n\
\n\
\n\
 ";

char *list[7]={"daniel","eduardo","quintero","villegas","veronica","garcia","herrera"};
void (*p)(void);

float u=0;



uint32_t fact(uint32_t input)
{
    if (input == 0)
            return 1;
    else    
        return input * fact(input - 1);
}

int main(){
	MODE=0;

    myprintf("%s\n",instructions_msg);
	for (int i = 0; i < 7; ++i)
  {
    myprintf("%s\n",list[i]);
 
  }
  for (int i = 0; i < 7; ++i)
  {
       strcpy(list[i],"empty");
  }
  for (int i = 0; i < 7; ++i)
  {
    myprintf("%s\n",list[i]);
 
  }

 myprintf("emulador de cpu riscv32im, portado a un esp8266, con 2 memorias sram 23lc1024\n");
 
 uint32_t sum1=0;
 uint32_t sum2=0;
 float res=0;

 for (int i = 0; i < sizeof(rawData); ++i)
 {
 	sum1+=rawData[i];
 }
 for (uint32_t i = 0; i < sizeof(rawData2); ++i)
 {
 	sum2+=rawData2[i];
 }
 


sum1;
myprintf("\n test %l ",sum1);
myprintf("\nsize: %i,size:%i -- sum1: %i , sum2: %l \n",sizeof(rawData),sizeof(rawData2),sum1 & 0xffff,sum2);
 
res=sum1*0.9;
myprintf("res: ");
floatprint(res*_pow_(10,-2));
myprintf("\n");

res=sum2*0.9;
myprintf("res: ");
floatprint(res*_pow_(10,-2));
myprintf("\n");

for (int i = 0; i < 20; ++i)
{
	myprintf("%l \n",fact(i));
}

char c;
while(1){
	if(ENRX){
		c=RX;
		myprintf("%c",c);
		if(c=='x')break;
	}
}
 
 ENT0=1;

    while(1){

       myprintf("riscv cpu run! ");
       myprintf("%f\n\r",u);

       for (int i = 0; i < 20; ++i){
	        myprintf("%l \n",fact(i));
       }
       u+=0.1;
       for (int i = 0; i < 100; ++i)
       {
       	   asm("nop");
       }
    }
	return 0;
}